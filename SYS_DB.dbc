VERSION ""

NS_ :

BS_:

BU_: ECU2_SPEED ECU1_ACC

BO_ 128 MSG_SPEED: 1 ECU2_SPEED
 SG_ SIG_SPEED : 0|8@1+ (1,0) [0|255] "" Vector__XXX

BO_ 48 MSG_ACC: 1 ECU1_ACC
 SG_ SIG_ACC : 0|1@1+ (1,0) [0|1] "" Vector__XXX

BA_DEF_  "BusType" STRING ;
BA_DEF_DEF_  "BusType" "";
BA_ "BusType" "CAN";
